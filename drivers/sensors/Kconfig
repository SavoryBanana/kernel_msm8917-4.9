## drivers/sensors/Kconfig
```kconfig
config SENSORS
	bool "Sensors Class Support"
	help
	  This option enables the sensor sysfs class in /sys/class/sensors.
	  You'll need this to do anything useful with sensorss. If unsure, say N.

config SENSORS_SSC
	bool "Enable Sensors Driver Support for SSC"
	help
	  Add support for sensors SSC driver.
	  This driver is used for exercising sensors use case,
	  time syncing with ADSP clock.

source "drivers/sensors/cm36686/Kconfig"
source "drivers/sensors/lis2ds/Kconfig"
source "drivers/sensors/stk3328/Kconfig"
```

## drivers/sensors/cm36686/Kconfig
```kconfig
config SENSORS_CM36686
	depends on I2C
	tristate "CM36686 driver"
	default n
	help
	  This option enables proximity & light sensors using CM36686 driver.
```

## drivers/sensors/lis2ds/Kconfig
```kconfig
config SENSORS_LIS2DS
	tristate "STMicroelectronics LIS2DS/LIS2DS12 sensors"
	depends on (I2C || SPI) && SYSFS
	help
	   This driver support the STMicroelectronics LIS2DS/LIS2DS12 sensors.
	   It is a accelerometer device.
	   To compile this driver as a module, choose M here. The module
	   will be called lis2ds.

config SENSORS_LIS2DS_I2C
	tristate "STMicroelectronics LIS2DS/LIS2DS12 sensors"
	depends on (I2C || SPI) && SYSFS
	help
	   This driver support the STMicroelectronics LIS2DS/LIS2DS12 sensors.
	   It is a accelerometer device.
	   To compile this driver as a module, choose M here. The module
	   will be called lis2ds.\
```

## drivers/sensors/stk3328/Kconfig
```kconfig
config SENSORS_STK3328
	depends on I2C
	tristate "STK3328 driver"
	default n
	help
	  This option enables proximity & light sensors using STK3328 driver.
```

## drivers/soc/samsung/Kconfig
```kconfig
#
# SAMSUNG SoC drivers
#
config DRV_SAMSUNG
	bool "samsung device dedicated drivers option"
	default y
	help
	  This is driver option for samsung sec_class
	  Say y here to enable samsung classes for drivers
	  Provide option of enabling sec class
	  Supports sec drivers key, touch, sec_debug et

config EXYNOS_PMU
	bool "Exynos PMU controller driver" if COMPILE_TEST
	depends on (ARM && ARCH_EXYNOS) || ((ARM || ARM64) && COMPILE_TEST)

config EXYNOS_PM_DOMAINS
	bool "Exynos PM domains" if COMPILE_TEST
	depends on PM_GENERIC_DOMAINS || COMPILE_TEST
```
